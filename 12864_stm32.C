#include "stm32f10x.h"
//深圳市绘晶科技显示模组；STM32例程。公司网址 www.huijinglcm.com
//12864-7920-M68-8Bit/4Bit-I2C    


#define	Stop	//是否让程序暂停(选择后，STM32-PB2脚 触碰高电平时显示内容会停止，)

//选择通迅方式
u8 PSB_in=1;				//1为并口；0为串口(如果显示器已固定，则按固定的方式显示)

//选择并口8位还是4位
u8	M_68=8;					//8是8位；4是4位

u16 Refresh_time=500;//显示内容间隔时间ms



//显示屏与STM32_GPIO连接
/*  例如：12864ZW
1	PB13	VSS
2	PB12	VDD
3	PB11	V0
4	PB10	RS
5	PB1		WR
6	PB0		E
7	PA7		D0
8	PA6		D1
9	PA5		D2
10	PA4		D3
11	PA3		D4
12	PA2		D5
13	PA1		D6
14	PA0		D7
15	PB9		PSB
16	PB8		NC
17	PB7		RST
18	PB6		VOUT
19	PB14	A
20	PB15	K
*/

//端口高电平	 OK
#define LCD_RS_H		GPIO_SetBits(GPIOB,GPIO_Pin_10)	//	(对应显示屏的第4脚)
#define	LCD_WR_H		GPIO_SetBits(GPIOB,GPIO_Pin_1)	//	
#define	LCD_E_H			GPIO_SetBits(GPIOB,GPIO_Pin_0)	//
#define	LCD_D0_H		GPIO_SetBits(GPIOA,GPIO_Pin_7)	//
#define	LCD_D1_H		GPIO_SetBits(GPIOA,GPIO_Pin_6)	//
#define	LCD_D2_H		GPIO_SetBits(GPIOA,GPIO_Pin_5)	//
#define	LCD_D3_H		GPIO_SetBits(GPIOA,GPIO_Pin_4)	//
#define	LCD_D4_H		GPIO_SetBits(GPIOA,GPIO_Pin_3)	//
#define	LCD_D5_H		GPIO_SetBits(GPIOA,GPIO_Pin_2)	//
#define LCD_D6_H		GPIO_SetBits(GPIOA,GPIO_Pin_1)
#define LCD_D7_H		GPIO_SetBits(GPIOA,GPIO_Pin_0)
#define LCD_PSB_H		GPIO_SetBits(GPIOB,GPIO_Pin_9)	
//NC
#define LCD_RST_H		GPIO_SetBits(GPIOB,GPIO_Pin_7)	//	(对应显示屏的第17脚)
//vee

//端口低电平
#define LCD_RS_L		GPIO_ResetBits(GPIOB,GPIO_Pin_10)	//	(对应显示屏的第4脚)
#define	LCD_WR_L		GPIO_ResetBits(GPIOB,GPIO_Pin_1)	//	
#define	LCD_E_L			GPIO_ResetBits(GPIOB,GPIO_Pin_0)	//
#define	LCD_D0_L		GPIO_ResetBits(GPIOA,GPIO_Pin_7)	//
#define	LCD_D1_L		GPIO_ResetBits(GPIOA,GPIO_Pin_6)	//
#define	LCD_D2_L		GPIO_ResetBits(GPIOA,GPIO_Pin_5)	//
#define	LCD_D3_L		GPIO_ResetBits(GPIOA,GPIO_Pin_4)	//
#define	LCD_D4_L		GPIO_ResetBits(GPIOA,GPIO_Pin_3)	//
#define	LCD_D5_L		GPIO_ResetBits(GPIOA,GPIO_Pin_2)	//
#define LCD_D6_L		GPIO_ResetBits(GPIOA,GPIO_Pin_1)
#define LCD_D7_L		GPIO_ResetBits(GPIOA,GPIO_Pin_0)
#define LCD_PSB_L		GPIO_ResetBits(GPIOB,GPIO_Pin_9)	
//NC
#define LCD_RST_L		GPIO_ResetBits(GPIOB,GPIO_Pin_7)	//	(对应显示屏的第17脚)

//函数声明
//4------------------------用户层004———————————————————————————————————
//int m-ain(void);

//3————————————————————————LCD应用层003————————————————————————————————
void judge_psb(void);	//判断PSB有没有连接
void LCDInit(void);		//初始化LCD-8位接口
void ShowQQCharH(u8 addr,u8 *hanzi,u8 count);
void ShowNUMCharH(u8 addr,u8 i,u8 count);
void WRCGRAMH(u8 data1,u8 data2,u8 addr);
void ShowCGCharH(u8 addr,u8 i);
void WRGDRAM128X8(u8 x1,u8 y1,u8 d1 );
void WRGDRAM_use(u8 x1,u8 y1,u8 xw,u8 yh,u8 *d1,u8 fb );//自定义大小写入图形
void CLEARGDRAMH(u8 c);
void WRGDRAM1(u8 x,u8 l,u8 r );
void ShowText_7920(u8 column,u8 *text);


//2————————————————————————LCD时序层002————————————————————————————————

void RDBF(void);
void WRCommand_M68(u8 comm);//写数据到指令寄存器
void WRData_M68(u8 TEMP);//写数据到数据寄存器
void WRCommand_P(u8 comm);//写数据到指令寄存器
void WRData_P8(u8 TEMP);//写数据到数据寄存器

/////////////////////////////////////////////////////////////////////////////////
//以下是串口时开的读写时序

void SendByteLCDH(u8 WLCDData);
void SPIWH(u8 Wdata,u8 WRS);
void WRCommand_S(u8 CMD);
void WRData_S(u8 Data);
void WRCommandH(u8 CMD);
void WRDataH(u8 Data);


//1————————————————————————STM32配置001————————————————————————————————
void RCC_Configuration(void);	//单片机系统时钟初始化
void GPIO_Configuration(void);	//单片机端口配置
void GPIO_Configuration_PSB(void);	
void GPIO_Configuration_D7(void);
void delay(u32 nCount);		//延时函数
void delay_us(u32 nus);		//*1us
void delay_ms(u16 nms);		//*1ms

//0————————————————————————LCD数据 ————————————————————————————————
//汉字,直接可以写入字形,写入标点符号后要加空格键
unsigned char  uctech[] = {"绘晶科技公司地址区石岩镇麻布第二"};
//显示在第1，3行
unsigned char  uctech3[] = {"广东省深圳市宝安工业区第4 栋2 楼"};
//显示在第2，4行
unsigned char  uctech6[] = {"汇            精焦   128*64   至"};
//显示在第1，3行
unsigned char  uctech7[] = {"聚  绘晶科技  品点  23146001  上"};
//显示在第2，4行
unsigned char  uctech1[] = {"绘晶科技"};
//显示在第2行
unsigned char  uctech2[] = {" 128*64 "};
//显示在第3行
unsigned char  uctech4[] = {"TIME"};
unsigned char  uctech5[] = {"绘晶科技23146001"};
unsigned char  uctech8[] = {"有8192个中文字型"};
unsigned char  uctech9[] = {"有126 个字母符号"};
unsigned char  xyz128_11[];	
unsigned char  lg_12864[];	
unsigned char  rn_6464[];	
unsigned char  ew_6464[];	


unsigned char   ff100_3208[];
unsigned char   Err_6408[];
unsigned char   sw6_3218[];
unsigned char   qi_3212[];
unsigned char   zt_1612[];
unsigned char   temp_1607[];
unsigned char   sd_9610[];


//定义一些变量
u8 m1,z,z1,d,d1,s,s1,s10,s100;
u8 PSB_CC;

//以下为所有函数体

void PORT_Assignment(unsigned char WriteData)//因为字节的位是乱的，用到这个函数
{
	if (WriteData & 0x01)  LCD_D0_H;	else	LCD_D0_L;
	if (WriteData & 0x02)  LCD_D1_H;    else	LCD_D1_L;
	if (WriteData & 0x04)  LCD_D2_H;    else	LCD_D2_L;
	if (WriteData & 0x08)  LCD_D3_H;    else	LCD_D3_L;
	if (WriteData & 0x10)  LCD_D4_H;    else	LCD_D4_L;
	if (WriteData & 0x20)  LCD_D5_H;    else	LCD_D5_L;
	if (WriteData & 0x40)  LCD_D6_H;   else	LCD_D6_L;
	if (WriteData & 0x80)  LCD_D7_H;   else	LCD_D7_L;
}

//------------------------用户层004———————————————————————————————————
/*
int main(void)
	RCC_Configuration();	//单片机系统时钟初始化
	GPIO_Configuration();	//单片机端口配置
	delay_ms(Refresh_time)	;
*/

//主函数
int main(void)
{
	u8 i;
	RCC_Configuration();	//单片机系统时钟初始化
	GPIO_Configuration();	//单片机端口配置	
//~~~~~~~~~~~~~~~~~~~~~~~~~~~~~~~~~~~~~~~~~~~~~参考应用
	while(1)
	{
		d1=s=s1=s10=s100=0;
		for(m1=0;m1<5;m1++)	
		{
			LCDInit();//初始化
			
			if(PSB_CC==1)		{ShowText_7920(0,"检测到PSB 短接到地，固定串口");	}
			else if(PSB_CC==2)	{ShowText_7920(0,"检测到PSB 短接到高，固定并口");}
			else if(PSB_CC==3)	{ShowText_7920(0,"软件设置地，串口");}
			else if(PSB_CC==4)	{ShowText_7920(0,"软件设置高，并口");}
			delay_ms(Refresh_time);		//等待时间	
		
			LCDInit();//初始化
		//	WRCommandH(0x01);delay_ms(20);	//清除显示DDRAM 
			ShowNUMCharH(0x80,0x01,32);//显示半宽特殊符号
			ShowNUMCharH(0x90,0x30,32);//显示半宽0~?数字标点
			delay_ms(Refresh_time);		//等待时间	
	//~~~~~~~~~~~~~~~~~~~~~~~~~~~~~~~~~~~~~~~~~~~~~~1，显示8*16字符		
			LCDInit();//初始化	
			ShowQQCharH(0x80," 300",2);delay_ms(210);
			CLEARGDRAMH(0x00);	//清除显示绘图

		//zt_1612	钻头
			WRGDRAM_use(3,8,1,12,zt_1612,0);	delay_ms(210);		
		//temp_1607	温度	
			WRGDRAM_use(3,0,1,7,temp_1607,0);delay_ms(210);
			WRGDRAM_use(3,21,1,7,temp_1607,0);delay_ms(210);
			WRGDRAM_use(5,0,1,7,temp_1607,0);delay_ms(210);
			WRGDRAM_use(5,21,1,7,temp_1607,0);	delay_ms(210);
		//qi_3212	
			WRGDRAM_use(4,8,2,12,qi_3212,0);delay_ms(210);
		//	数码开关
			WRGDRAM_use(6,2,2,18,sw6_3218,0);	delay_ms(210);	
		//  三轴坐标	
			WRGDRAM_use(0,29,8,11,xyz128_11,0);	delay_ms(210);		
		//	SD卡
			WRGDRAM_use(0,43,2,8,ff100_3208,0);	delay_ms(210);		
		//sd_9610	
			WRGDRAM_use(2,43,6,10,sd_9610,0);	delay_ms(210);			
		//	单片机机
			WRGDRAM_use(0,56,4,8,Err_6408,0);	delay_ms(210);
			
			for(i=0;i<6;i++)	//反白演示
			{
				WRGDRAM_use(0,29,8,11,xyz128_11,1);	delay_ms(350);	
				WRGDRAM_use(0,29,8,11,xyz128_11,0);	delay_ms(350);	
			}
			
			delay_ms(Refresh_time);		//等待时间
			LCDInit();//初始化
			WRCommandH(0x01);delay_ms(30);	//清除显示DDRAM 	
			CLEARGDRAMH(0x00);		
			WRGDRAM_use(0,0,8,64,lg_12864,0);	delay_ms(210);	
			delay_ms(Refresh_time);		//等待时间	
				
				CLEARGDRAMH(0x00);
			WRGDRAM_use(2,0,4,64,rn_6464,0);	delay_ms(210);	
			delay_ms(Refresh_time);		//等待时间				
				
					CLEARGDRAMH(0x00);
			WRGDRAM_use(2,0,4,64,ew_6464,0);	delay_ms(210);	
			delay_ms(Refresh_time);		//等待时间				
			WRGDRAM_use(2,0,4,64,ew_6464,1);	delay_ms(210);	
			delay_ms(Refresh_time);		//等待时间	
			
			CLEARGDRAMH(0x00);
			LCDInit();//初始化	
			WRCommandH(0x01);delay_ms(20);	//清除显示DDRAM 
			WRCGRAMH(0xff,0x00,0x40);//写入横（自编特殊符号）
			WRCGRAMH(0x00,0xff,0x50);//写入横2
			WRCGRAMH(0xaa,0xaa,0x60);//写入竖
			WRCGRAMH(0x55,0x55,0x70);//写入竖2	
			
	//	LCDInit();//初始化
			ShowCGCharH(0x80,0x00);//显示横并填满
			delay_ms(Refresh_time);		//等待时间
	//~~~~~~~~~~~~~~~~~~~~~~~~~~~~~~~~~~~~~~~~~~~~~~2，隔横显示		
		//	WRCommandH(0x01);	delay_ms(20);//清除显示DDRAM
		LCDInit();//初始化
			ShowCGCharH(0x80,0x02);//显示横2并填满
			delay_ms(Refresh_time);		//等待时间
	//~~~~~~~~~~~~~~~~~~~~~~~~~~~~~~~~~~~~~~~~~~~~~~3，隔横显示
		//	WRCommandH(0x01);	delay_ms(20);//清除显示DDRAM
		LCDInit();//初始化
			ShowCGCharH(0x80,0x04);//显示竖并填满
			delay_ms(Refresh_time);		//等待时间
	//~~~~~~~~~~~~~~~~~~~~~~~~~~~~~~~~~~~~~~~~~~~~~~4，隔列显示		
		//	WRCommandH(0x01);	delay_ms(20);//清除显示DDRAM
		LCDInit();//初始化
			ShowCGCharH(0x80,0x06);//显示竖2并填满
			delay_ms(Refresh_time);		//等待时间
	//~~~~~~~~~~~~~~~~~~~~~~~~~~~~~~~~~~~~~~~~~~~~~~5，隔列显示

			LCDInit();//初始化
		//	WRCommandH(0x01);	delay_ms(20);//清除显示DDRAM
			WRCGRAMH(0x00,0x00,0x40);//清CGRAM1（重复使用自编）
			WRCGRAMH(0x00,0x00,0x50);//清CGRAM2
			
			WRCGRAMH(0xaa,0x55,0x40);//写入点（自编特殊符号）	
			WRCGRAMH(0x55,0xaa,0x50);//写入点2

			LCDInit();//初始化
			ShowCGCharH(0x80,0x00);//显示点并填满
			delay_ms(Refresh_time);		//等待时间
	//~~~~~~~~~~~~~~~~~~~~~~~~~~~~~~~~~~~~~~~~~~~~~~6，隔点显示
			//WRCommandH(0x01);delay_ms(20);	//清除显示DDRAM
			LCDInit();//初始化
			ShowCGCharH(0x80,0x02);//显示点2并填满
			delay_ms(Refresh_time);		//等待时间
	//~~~~~~~~~~~~~~~~~~~~~~~~~~~~~~~~~~~~~~~~~~~~~~7，隔点显示

			//显示汉字一屏
			LCDInit();//初始化		
			ShowQQCharH(0x80,uctech,16);//调用字库
			ShowQQCharH(0x90,uctech3,16);
			CLEARGDRAMH(0x00);	//清除显示绘图
			WRGDRAM128X8(0,0,0xff);//单独一行反白
			delay_ms(Refresh_time);		//等待时间	
			
			WRGDRAM128X8(0,0,0x00);//清
			WRGDRAM128X8(0,17,0xff);//单独一行反白
			delay_ms(Refresh_time);		//等待时间	
			
			WRGDRAM128X8(0,17,0x00);//清
			WRGDRAM128X8(8,0,0xff);//单独一行反白
			delay_ms(Refresh_time);		//等待时间	
	
				WRGDRAM128X8(8,0,0x00);//清
			WRGDRAM128X8(8,17,0xff);//单独一行反白
			delay_ms(Refresh_time);		//等待时间	
	
	//~~~~~~~~~~~~~~~~~~~~~~~~~~~~~~~~~~~~~~~~~~~~~~8，显示内部汉字		
	//~~~~~~~~~~~~~~~~~~~~~~~~~~~~~~~~~~~~~~~~~~~~~演示单行反白				
			LCDInit();//初始化	
			ShowQQCharH(0x92,uctech1,4);//显示'绘晶科技'
			ShowQQCharH(0x8A,uctech2,4);//显示' 128*64 '
			CLEARGDRAMH(0x00);	//清除显示绘图
			WRGDRAM1(0xff,0xc0,0x03);			//绘图演示-画边框 	
			delay_ms(Refresh_time);		//等待时间		
	//~~~~~~~~~~~~~~~~~~~~~~~~~~~~~~~~~~~~~~~~~~~~~~8，显示图文混合			
	//~~~~~~~~~~~~~~~~~~~~~~~~~~~~~~~~~~~~~~~~~~~~~~文字+边框
			LCDInit();//初始化
			ShowQQCharH(0x80,uctech6,16);//调用字库
			ShowQQCharH(0x90,uctech7,16);				
			CLEARGDRAMH(0xff);	//		
			delay_ms(Refresh_time);		//等待时间		
	//~~~~~~~~~~~~~~~~~~~~~~~~~~~~~~~~~~~~~~~~~~~~~~9，显示图文混合	
	//~~~~~~~~~~~~~~~~~~~~~~~~~~~~~~~~~~~~~~~~~~~~文字+全显（反白）
		}
	//------------------------------------- -以下老化测试99小时
	//~~~~~~~~~~~~~~~~~~~~~~~~~~~~~~~~~~~~~~~~~~~文字左移
		LCDInit();//初始化	
		ShowQQCharH(0x80,uctech4,2);//调用字库	
		ShowQQCharH(0x90,uctech9,8);//调用字库	
		ShowQQCharH(0x88,uctech8,8);//调用字库	
		ShowQQCharH(0x98,uctech5,8);//调用字库		
		for(z=0;z<10;z++)
		{	if(d1==1) break;
			WRCommandH(0x80+2);//写地址
			WRDataH(0x3a);
			WRDataH(0x30+z);	//分10		
			for(z1=0;z1<10;z1++)
			{	if(d1==1) break;
				WRCommandH(0x80+3);//写地址		
				WRDataH(0x30+z1);	//分10		
				WRDataH(0x3a);
				for(d=0;d<6;d++)
				{		if(d1==1) break;				
					for(d1=0;d1<10;d1++)
					{	
						WRCommandH(0x80+4);//写地址
						WRDataH(0x30+d);	//分10
						WRDataH(0x30+d1);	//分01	
	//					WRCommandH(0x10);
						if(d1==1) break;	
						for(s=0;s<6;s++)
						{					
							WRCommandH(0x80+5);//写地址
							WRDataH(0x3a);	
							WRDataH(0x30+s);	//秒10	
		
							for(s1=0;s1<10;s1++)
							{
								WRCommandH(0x80+6);//写地址
								WRDataH(0x30+s1);		//秒01
								WRDataH(0x3a);			
								delay_ms(20);////延时 x ms
								WRCommandH(0x18);								
								for(s10=0;s10<10;s10++)
								{									
									delay_ms(10);////延时 x ms	
									for(s100=0;s100<10;s100++)
									{
									WRCommandH(0x80+7);//写地址
									WRDataH(0x30+s10);//100MS
									WRDataH(0x30+s100);//10MS
									delay_ms(10);////延时 x ms	
									}
								}
							}
						}
					}
				}	
			}	
		}		
	}
}


//————————————————————————LCD应用层003————————————————————————————————
void judge_psb(void)
{
    u8 ad1,ad2;
	//PSB_CH();
	GPIO_Configuration();
	LCD_PSB_L;delay_us(1);				//假设PSB为0（串口），延时一下
	GPIO_Configuration_PSB();			//读
	if(GPIO_ReadInputDataBit(GPIOB,GPIO_Pin_9)==Bit_SET)ad1=1 ; else ad1=0;
	//ad1=PSB;						//读PSB的值，
	if(ad1==0)						//假设是0，读出来还是0，不代表就是0，因为如果是个悬空时也是0
	{
		GPIO_Configuration();
		LCD_PSB_H;delay_us(1);			//再假设高电平（并口），延时一下（防止误操作）
		GPIO_Configuration_PSB();
		if(GPIO_ReadInputDataBit(GPIOB,GPIO_Pin_9)==Bit_SET)ad2=1 ; else ad2=0;
		//ad2=PSB;					//读PSB值 
		if(ad2==1)					//第2次假设为高电平也能读出高电平（高低是可控，说明没有固定通迅方式）
		{
			if(PSB_in==1) {GPIO_Configuration();LCD_PSB_H;PSB_CC=4;}//按程序的配置1为并口，0为串口 
			else {GPIO_Configuration();LCD_PSB_L;PSB_CC=3;}
		}
		else {GPIO_Configuration();LCD_PSB_L;PSB_CC=1;}		
	}
	else {GPIO_Configuration();LCD_PSB_H;PSB_CC=2;}		//如果假设0,读出来是1，说明是并口，CC=2	
}


//初始化LCD-8位接口
void LCDInit(void)
{ 	
	judge_psb();	//检测PSB状态，配置高低电平
	
    LCD_RST_H;
    LCD_RST_L;
	delay_ms(40);
    LCD_RST_H;		//硬复位
	delay_ms(1);
	if(M_68==4)	WRCommandH(0x20);
	else 		WRCommandH(0x30);
  	delay_ms(1);	//基本指令集,8/4位
	
	WRCommandH(0x06);delay_ms(1);	//启始点设定：光标右移
	WRCommandH(0x01);delay_ms(11);	//清除显示DDRAM
	WRCommandH(0x0C);delay_ms(1);	//显示状态开关：整体显示开，光标显示关，光标显示反白关
	WRCommandH(0x02);delay_ms(1);//地址归零		
}

//addr为汉字显示位置,*hanzi汉字指针;count为输入汉字串字符数
void ShowQQCharH(u8 addr,u8 *hanzi,u8 count)
{	
	u8 i;
	WRCommandH(addr);	//设定DDRAM地址
	for(i=0;i<count;)
	{	
	    WRDataH(hanzi[i*2]);
        WRDataH(hanzi[i*2+1]);
		i++;
    }
}

//addr为半宽字符首个地址,i为首个半宽字符代码,count为需要输入字符个数
void ShowNUMCharH(u8 addr,u8 i,u8 count)
{
     u8 j;
	for(j=0;j<count;)
	{	
	    WRCommandH(addr);	//设定DDRAM地址
		WRDataH(i+j);//必为两个16*8位字符拼成一个16*16才能显示
		j++;
		WRDataH(i+j);
		addr++;
		j++;
	}		
}

//自定义字符写入CGRAM
//data1是高八位,data2是低八位,一存必须存两个字节,横向存两字节,后纵向累加,共16行
//一个自定义字符为16*16点阵
//第一个存入字节为从40H开始,到4F结束为第一个自定义汉字符, 之后调出地址从8000H为始第一个
//addr为存入头地址
void WRCGRAMH(u8 data1,u8 data2,u8 addr)
{     
      u8 i;
      for(i=0;i<16;)
  {
      WRCommandH(addr+i); 	//设定CGRAM地址
      WRDataH(data1);//delay_us(2);
	  WRDataH(data1);//delay_us(2);
      i++;
	  WRCommandH(addr+i);  	//设定CGRAM地址
	  WRDataH(data2);//delay_us(2);
	  WRDataH(data2);//delay_us(2);
      i++;
  }  
}
//自定义字符写入CGRAM
//显示上半屏自定义的字符,并把这个字符填满全屏16*16
//addr为显示地址,把自定义字符当一个汉字调出,从8000H开始为第一个,
//8100H为第二个,8200H为第三个,8300H为第四个,中文字库只能自定义四个字符
//i为自定义字符调出地址,先输入低位,再输入高位
//IC决定,中文字库类,一个IC最多只能显示16*2个汉字
void ShowCGCharH(u8 addr,u8 i)
{
     u8 j;
	for(j=0;j<0x20;)
	{	
	    WRCommandH(addr+j);	//设定DDRAM地址
		WRDataH(0x00);//delay_us(10);//字符地址低八位
	    WRDataH(i);//delay_us(10);//字符地址高八位
		j++;
	}		
}

void WRGDRAM128X8(u8 x1,u8 y1,u8 d1 )
{    
	u8 j,i; 
	if(M_68==4)	
	{
		WRCommandH(0x24);			//去扩展指令寄存器
		WRCommandH(0x26);		//打开绘图功能		
	}
	else
	{
		WRCommandH(0x34);			//去扩展指令寄存器
		WRCommandH(0x36);		//打开绘图功能		
	}

	for(j=0;j<16;j++)				//
	{   
		WRCommandH(0x80+y1+j);  //Y总坐标,即第几行
		WRCommandH(0x80+x1);	//X坐标，即横数第几个字节开始写起,80H为第一个字节
		for(i=0;i<8;i++)	//写入一行
		{
			WRDataH(d1);
			WRDataH(d1);
		}
	}
}

void WRGDRAM_use(u8 x1,u8 y1,u8 xw,u8 yh,u8 *d1,u8 fb )
{    
	u8 j,i;      
	if(M_68==4)	
	{
		WRCommandH(0x24);			//去扩展指令寄存器
		WRCommandH(0x26);		//打开绘图功能		
	}
	else
	{
		WRCommandH(0x34);			//去扩展指令寄存器
		WRCommandH(0x36);		//打开绘图功能		
	}
	
	if((y1+yh)>32)	//如果超出上半屏的内容
	{
		if(y1>31)	//如果起始行都超过了下半屏
		{
			for(j=0;j<yh;j++)				//
			{   
				WRCommandH(0x80+y1-32+j);  //Y总坐标,即第几行
				WRCommandH(0x80+8+x1);	//X坐标，即横数第几个字节开始写起,80H为第一个字节
				for(i=0;i<xw;i++)	//写入一行
				{
					if(fb==0)	WRDataH(*d1);	else WRDataH(~(*d1));
					d1++;
					if(fb==0)	WRDataH(*d1);	else WRDataH(~(*d1));
					d1++;
				}
			}
		}
		else  
		{		
			for(j=0;j<(32-y1);j++)				//
			{   
				WRCommandH(0x80+y1+j);  //Y总坐标,即第几行
				WRCommandH(0x80+x1);	//X坐标，即横数第几个字节开始写起,80H为第一个字节
				for(i=0;i<xw;i++)	//写入一行
				{
					if(fb==0)	WRDataH(*d1);	else WRDataH(~(*d1));
					d1++;
					if(fb==0)	WRDataH(*d1);	else WRDataH(~(*d1));
					d1++;
				}					
			}
			for(j=0;j<(yh-(32-y1));j++)				//
			{   
				WRCommandH(0x80+j);  //Y总坐标,即第几行
				WRCommandH(0x80+8+x1);	//X坐标，即横数第几个字节开始写起,80H为第一个字节
				for(i=0;i<xw;i++)	//写入一行
				{
					if(fb==0)	WRDataH(*d1);	else WRDataH(~(*d1));
					d1++;
					if(fb==0)	WRDataH(*d1);	else WRDataH(~(*d1));
					d1++;
				}					
			}			
		}
	}
	else		//列数 在上半屏范围内
	{
		for(j=0;j<yh;j++)				//
		{   
			WRCommandH(0x80+y1+j);  //Y总坐标,即第几行
			WRCommandH(0x80+x1);	//X坐标，即横数第几个字节开始写起,80H为第一个字节
			for(i=0;i<xw;i++)	//写入一行
			{
				if(fb==0)	WRDataH(*d1);	else WRDataH(~(*d1));
				d1++;
				if(fb==0)	WRDataH(*d1);	else WRDataH(~(*d1));
				d1++;
			}
		}				
	}
	
}


//上半屏清除图形区数据
void CLEARGDRAMH(u8 c)
{    
	u8 j;
	u8 i;
	if(M_68==4)	
	{
		WRCommandH(0x24);			//去扩展指令寄存器
		WRCommandH(0x26);		//打开绘图功能		
	}
	else
	{
		WRCommandH(0x34);			//去扩展指令寄存器
		WRCommandH(0x36);		//打开绘图功能		
	}
	for(j=0;j<32;j++)
	{
		WRCommandH(0x80+j);
		WRCommandH(0x80);//X坐标
		for(i=0;i<16;i++)//
		{
			WRDataH(c);
			WRDataH(c);
		}
	}
}

void WRGDRAM1(u8 x,u8 l,u8 r )
{    

	u8 j;
	u8 i; 
	if(M_68==4)	
	{
		WRCommandH(0x24);			//去扩展指令寄存器
		WRCommandH(0x26);		//打开绘图功能		
	}
	else
	{
		WRCommandH(0x34);			//去扩展指令寄存器
		WRCommandH(0x36);		//打开绘图功能		
	}
	//两横的上边框 下边框
	for(j=0;j<2;j++)				//2行 
	{   
		WRCommandH(0x80+j);  //Y总坐标,即第几行
		WRCommandH(0x80);	//X坐标，即横数第几个字节开始写起,80H为第一个字节
		for(i=0;i<8;i++)	//写入一行
		{
			WRDataH(x);
			WRDataH(x);
		}
		WRCommandH(0x80+30+j);  //Y总坐标,即第几行
		WRCommandH(0x80+8);	//X坐标，即横数第几个字节开始写起,80H为第一个字节
		for(i=0;i<8;i++)	//写入一行
		{
			WRDataH(x);
			WRDataH(x);
		}
	}
	//上半屏两横的右左边框  
	for(j=2;j<32;j++)				//30行  左
	{   //先上半屏
		WRCommandH(0x80+j);  //Y总坐标,即第三行开始
		WRCommandH(0x80);	//X坐标，即横数第几个字节开始写起,80H为第一个字节
		WRDataH(l);
		WRDataH(0x00);		
		WRCommandH(0x80+j);  //Y总坐标,即第三行开始
		WRCommandH(0x80+7);	//X坐标，即横数第几个字节开始写起,80H为第一个字节
		WRDataH(0x00);WRDataH(r);
	}	

	//下半屏两横右左的边框  
	for(j=0;j<30;j++)				//30行   
	{   //
		WRCommandH(0x80+j);  //Y总坐标,即第一行开始
		WRCommandH(0x80+15);	//X坐标，即横数第几个字节开始写起,80H为第一个字节
		WRDataH(0x00);
		WRDataH(r);
		WRCommandH(0x80+j);  //Y总坐标,即第几行
		WRCommandH(0x80+8);	//X坐标，即横数第几个字节开始写起,80H为第一个字节
		WRDataH(l);			   WRDataH(0x00);
	}		  		   	 		   
}


void ShowText_7920(u8 column,u8 *text)
{	
	WRCommandH(0x80+column);	
	while(*text>0) 
	{
		WRDataH(*text); 
		text++; 
	} 
}

//————————————————————————LCD时序层002————————————————————————————————

//以下是并口时才开的
//读忙标志,

void RDBF(void)
{
	u8 temp;
	GPIO_Configuration_D7();	//上拉输入
	LCD_RS_L;	// LCD_RS_L	指令
	LCD_WR_H;	// LCD_WR_H	读'	
	while(1)
	{
		
		LCD_E_H;		//delay(5);
		if(GPIO_ReadInputDataBit(GPIOA,GPIO_Pin_0)==Bit_SET) temp=1;	else	temp=0;		//读状态字
		LCD_E_L;	//delay(10);	// E=0
		if ((temp&1)==0) break;
    }	
}
//写数据到指令寄存器
void WRCommand_M68(u8 comm)
{	
	RDBF();
	GPIO_Configuration();
	LCD_RS_L;
	LCD_WR_L;
	PORT_Assignment(comm);		//P1=comm;
	LCD_E_H;	//delay_us(2);
	LCD_E_L;	//delay_us(2);
}


//写数据到数据寄存器
void WRData_M68(u8 TEMP)
{
	RDBF();
	GPIO_Configuration();
	LCD_RS_H;
	LCD_WR_L;
	PORT_Assignment(TEMP);		//P1=TEMP;
	LCD_E_H; 	//delay_us(2);
	LCD_E_L;	//delay_us(2);
}

void WRCommand_P(u8 comm)
{	
	u8 da0,da1;
	if(M_68==8)	
		WRCommand_M68(comm);
	else if(M_68==4)
	{
		da0=comm&0x00f0;              //取DATA的高4位,
		da1=((comm&0x000f)<<4);       //取DATA的低4位,
		WRCommand_M68(da0);
		WRCommand_M68(da1);			
	}	
}

//写数据到数据寄存器
void WRData_P8(u8 TEMP)
{
	u8 da0,da1;
	if(M_68==8)	
		WRData_M68(TEMP);
	else if(M_68==4)
	{
		da0=TEMP&0x00f0;              //取DATA的高4位,
		da1=((TEMP&0x000f)<<4);       //取DATA的低4位,
		WRData_M68(da0);
		WRData_M68(da1);			
	}	
	
}

/////////////////////////////////////////////////////////////////////////////////
//以下是串口时开的读写时序

void SendByteLCDH(u8 WLCDData)
{
	u8 i;
	for(i=0;i<8;i++)
	{
		if((WLCDData<<i)&0x80)	LCD_WR_H;
		else LCD_WR_L;delay_us(1);	
		LCD_E_L;delay_us(1);	
		LCD_E_H;delay_us(1);	
	}
}

void SPIWH(u8 Wdata,u8 WRS)
{
	SendByteLCDH(0xf8+(WRS<<1));//寄存器选择WRS
	SendByteLCDH(Wdata&0xf0);
	SendByteLCDH((Wdata<<4)&0xf0);
}
 
void WRCommand_S(u8 CMD)
{
	LCD_RS_L;
	LCD_RS_H;
	SPIWH(CMD,0);
	//delay_us(1);
}

void WRData_S(u8 Data)
{ 
	LCD_RS_L;
	LCD_RS_H;
	SPIWH(Data,1);
}

//Bit_RESET   低电平
//Bit_SET	高电平
void WRCommandH(u8 CMD)
{
	if(PSB_CC==2||PSB_CC==4)	WRCommand_P(CMD);
		else if(PSB_CC==1||PSB_CC==3) WRCommand_S(CMD);
		delay_us(100);
}

void WRDataH(u8 Data)
{

	if(PSB_CC==2||PSB_CC==4)	WRData_P8(Data);	
		else if(PSB_CC==1||PSB_CC==3) WRData_S(Data);	
}

//————————————————————————STM32配置001————————————————————————————————
void delay(u32 nCount)		//1/72微秒延时函数纳秒
{
	for(;nCount!=0;nCount--);
}

void delay_us(u32 nus)		//微秒延时函数
{
	 u32 temp;
	 SysTick->LOAD = 9*nus;
	 SysTick->VAL=0X00;//清空计数器
	 SysTick->CTRL=0X01;//使能，减到零是无动作，采用外部时钟源
	 do
	 {
		temp=SysTick->CTRL;//读取当前倒计数值
	 }	while((temp&0x01)&&(!(temp&(1<<16))));//等待时间到达
	 
	 SysTick->CTRL=0x00; //关闭计数器
	 SysTick->VAL =0X00; //清空计数器
}

void delay_ms(u16 nms)		//毫秒延时函数
{
	 u32 temp;
	 SysTick->LOAD = 9000*nms;
	 SysTick->VAL=0X00;//清空计数器
	 SysTick->CTRL=0X01;//使能，减到零是无动作，采用外部时钟源
	 do
	 {
		temp=SysTick->CTRL;//读取当前倒计数值
		#ifdef Stop				
		if(GPIO_ReadInputDataBit(GPIOB,GPIO_Pin_2)==Bit_SET)	{while(1){delay(0xff); if (GPIO_ReadInputDataBit(GPIOB,GPIO_Pin_2)==Bit_SET) break;}}	//暂停
		#endif

	 }	while((temp&0x01)&&(!(temp&(1<<16))));//等待时间到达
	 SysTick->CTRL=0x00; //关闭计数器
	 SysTick->VAL =0X00; //清空计数器
}

void RCC_Configuration(void)
{
	SystemInit();
	RCC_APB2PeriphClockCmd(RCC_APB2Periph_AFIO,ENABLE);//1、打开复用时钟
	GPIO_PinRemapConfig(GPIO_Remap_SWJ_Disable,ENABLE);//2、调用重映射函数
	//进行上述配置后即可将JTAG下载引脚当成普通GPIO来使用了！
	RCC_APB2PeriphClockCmd(RCC_APB2Periph_GPIOA,ENABLE);
	RCC_APB2PeriphClockCmd(RCC_APB2Periph_GPIOB,ENABLE);
}

void GPIO_Configuration(void)
{
	
	GPIO_InitTypeDef GPIO_InitStructure;	
	
	GPIO_InitStructure.GPIO_Pin = GPIO_Pin_0|GPIO_Pin_1|GPIO_Pin_2|GPIO_Pin_3|GPIO_Pin_4|GPIO_Pin_5|GPIO_Pin_6|GPIO_Pin_7;//实验
	GPIO_InitStructure.GPIO_Speed=GPIO_Speed_50MHz;
	GPIO_InitStructure.GPIO_Mode=GPIO_Mode_Out_PP;//推挽输出
	GPIO_Init(GPIOA,&GPIO_InitStructure);		//
	
	GPIO_InitStructure.GPIO_Pin = GPIO_Pin_1|GPIO_Pin_7|GPIO_Pin_8|GPIO_Pin_9|GPIO_Pin_10|GPIO_Pin_0;//实验
	GPIO_InitStructure.GPIO_Speed=GPIO_Speed_50MHz;
	GPIO_InitStructure.GPIO_Mode=GPIO_Mode_Out_PP;//推挽输出
	GPIO_Init(GPIOB,&GPIO_InitStructure);	
	
	
#ifdef Stop	//PB2	KEY(暂停)
	GPIO_InitStructure.GPIO_Pin=GPIO_Pin_2;
	GPIO_InitStructure.GPIO_Mode=GPIO_Mode_IN_FLOATING;//有上拉，所以用浮空
	GPIO_Init(GPIOB,&GPIO_InitStructure);	
#endif	
	
}

//GPIO_Mode_IN_FLOATING		浮空
//GPIO_Mode_IPU				上拉输入


void GPIO_Configuration_PSB(void)	
{
	
	GPIO_InitTypeDef GPIO_InitStructure;	
		
	GPIO_InitStructure.GPIO_Pin=GPIO_Pin_9;
	GPIO_InitStructure.GPIO_Mode=GPIO_Mode_IN_FLOATING;//上拉输入
	GPIO_Init(GPIOB,&GPIO_InitStructure);		
}

void GPIO_Configuration_D7(void)	
{
	
	GPIO_InitTypeDef GPIO_InitStructure;	
	
	GPIO_InitStructure.GPIO_Pin=GPIO_Pin_0;
	GPIO_InitStructure.GPIO_Mode=GPIO_Mode_IPU;//上拉输入
	GPIO_Init(GPIOA,&GPIO_InitStructure);				
}


//————————————————————————LCD数据 ————————————————————————————————

unsigned char   xyz128_11[]={
/*--  调入了一幅图像：E:\B1_测试程序\便捷版专用-ARM32\取模-字体\xyz_128x11.bmp  --*/
/*--  宽度x高度=128x11  --*/
0x00,0x00,0x00,0x00,0x00,0x00,0x00,0x00,0x00,0x00,0x00,0x00,0x00,0x00,0x00,0x00,
0x00,0x00,0x00,0x00,0x00,0x00,0x00,0x00,0x00,0x00,0x00,0x00,0x00,0x00,0x00,0x00,
0x09,0x01,0x8C,0x60,0x18,0x11,0x01,0x8C,0x60,0x18,0x0F,0x00,0x0C,0x63,0x00,0xC0,
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0x00,0x00,0x00,0x00,0x00,0x00,0x00,0x00,0x00,0x00,0x00,0x00,0x00,0x00,0x00,0x00	
};	

unsigned char   ff100_3208[]={
/*--  调入了一幅图像：E:\B1_测试程序\便捷版专用-ARM32\取模-字体\FR100.bmp  --*/
/*--  宽度x高度=32x8  --*/
0x38,0x08,0x63,0x00,0x20,0x18,0x94,0xB4,0x30,0x08,0x94,0xB4,0x2E,0x08,0x94,0x88,
0x29,0x08,0x94,0x90,0x0D,0x08,0x94,0xAC,0x08,0x1C,0x63,0x2C,0x09,0x00,0x00,0x00
};

unsigned char   Err_6408[]={
/*--  调入了一幅图像：E:\B1_测试程序\便捷版专用-ARM32\取模-字体\Err.bmp  --*/
/*--  宽度x高度=64x8  --*/
0x78,0x00,0x00,0x25,0xC9,0x7B,0xD2,0xE0,0x40,0x00,0x00,0x3C,0x8D,0x22,0x1E,0x90,
0x40,0x00,0x40,0x3C,0x8D,0x22,0x1E,0x90,0x72,0xD6,0x00,0x24,0x8B,0x23,0x92,0xE0,
0x43,0x18,0x00,0x24,0x8B,0x22,0x12,0x80,0x42,0x10,0x40,0x24,0x89,0x22,0x12,0x80,
0x7A,0x10,0x00,0x25,0xC9,0x23,0xD2,0x80,0x00,0x00,0x00,0x00,0x00,0x00,0x00,0x00
};

unsigned char   sw6_3218[]={
/*--  调入了一幅图像：E:\B1_测试程序\便捷版专用-ARM32\取模-字体\sw6-2_3218.bmp  --*/
/*--  宽度x高度=32x18  --*/
0x01,0xFF,0xFF,0x80,0x01,0xC0,0x03,0x80,0x01,0x87,0xE1,0x80,0x01,0x07,0xE0,0x80,
0x01,0x03,0xC0,0x80,0x01,0x01,0x80,0x80,0x01,0x60,0x06,0x80,0x01,0x71,0x8E,0x80,
0x01,0x7B,0xDE,0x80,0x01,0x7B,0xDE,0x80,0x01,0x71,0x8E,0x80,0x01,0x60,0x06,0x80,
0x01,0x01,0x80,0x80,0x01,0x03,0xC0,0x80,0x01,0x07,0xE0,0x80,0x01,0x87,0xE1,0x80,
0x01,0xC0,0x03,0x80,0x01,0xFF,0xFF,0x80
};
unsigned char   qi_3212[]={
/*--  调入了一幅图像：E:\B1_测试程序\便捷版专用-ARM32\取模-字体\qi_3212.bmp  --*/
/*--  宽度x高度=32x12  --*/
0x00,0x41,0x04,0x00,0x00,0x20,0x82,0x00,0x00,0x20,0x82,0x00,0x00,0x41,0x04,0x00,
0x00,0x82,0x08,0x00,0x01,0x04,0x10,0x00,0x01,0x04,0x10,0x00,0x00,0x82,0x08,0x00,
0x00,0x41,0x04,0x00,0x00,0x00,0x00,0x00,0x01,0xFF,0xFF,0x80,0x01,0xFF,0xFF,0x80
};
unsigned char   zt_1612[]={
/*--  调入了一幅图像：E:\B1_测试程序\便捷版专用-ARM32\取模-字体\zt1012.bmp  --*/
/*--  宽度x高度=16x12  --*/
0x0F,0xF0,0x1F,0xF8,0x1F,0xF8,0x1F,0xF8,0x0F,0xF0,0x0F,0xF0,0x1F,0xF8,0x1F,0xF8,
0x1F,0xF8,0x07,0xE0,0x02,0x40,0x01,0x80
};
unsigned char   temp_1607[]={
/*--  调入了一幅图像：E:\B1_测试程序\便捷版专用-ARM32\取模-字体\0_du.bmp  --*/
/*--  宽度x高度=9x7  --*/
/*--  宽度不是8的倍数，现调整为：宽度x高度=16x7  --*/
0x70,0x00,0x89,0x00,0x8A,0x80,0x89,0x00,0x88,0x00,0x88,0x00,0x70,0x00
};

unsigned char   sd_9610[]={
/*--  调入了一幅图像：E:\B1_测试程序\便捷版专用-ARM32\取模-字体\sd_9610.bmp  --*/
/*--  宽度x高度=96x10  --*/
0x1F,0xF0,0x00,0x00,0x00,0x00,0x00,0x00,0x00,0x00,0x00,0x00,0x1F,0xF8,0x00,0x00,
0x00,0x00,0x00,0x10,0x00,0x00,0x00,0x00,0x1F,0xFC,0x00,0x00,0x01,0xF9,0xF8,0x00,
0x7E,0x3F,0x00,0x00,0x1F,0xFC,0x00,0x00,0x00,0x00,0x00,0x00,0x00,0x00,0x00,0x00,
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0xFF,0xFF,0xFF,0xFF,0xFF,0xFF,0xFF,0xFE
};

unsigned char   lg_12864[]={
/*--  调入了一幅图像：E:\`3`hj large files\1、源代码图片\制作图标图片\LOGO2.bmp  --*/
/*--  宽度x高度=128x64  --*/
0x00,0x00,0x00,0x00,0x00,0x00,0x00,0x00,0x00,0x00,0x00,0x00,0x00,0x00,0x00,0x00,
0x00,0x00,0x00,0x00,0x00,0x00,0x00,0x00,0x00,0x00,0x00,0x00,0x00,0x00,0x00,0x00,
0x00,0x00,0x00,0x00,0x00,0x1F,0xFF,0xF0,0x7F,0xFF,0xC0,0x00,0x00,0x00,0x00,0x00,
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0x00,0x00,0x00,0x00,0x00,0x00,0x00,0x00,0x00,0x00,0x00,0x00,0x00,0x00,0x00,0x00
};

unsigned char   rn_6464[]={
/*--  调入了一幅图像：E:\`3`hj large files\1、源代码图片\常用图标\64x64\24064表情路径图 4.bmp  --*/
/*--  宽度x高度=64x64  --*/
0x00,0x00,0x00,0x3F,0xF8,0x00,0x00,0x00,0x00,0x00,0x07,0xFF,0xFF,0x80,0x00,0x00,
0x00,0x00,0x3F,0xFF,0xFF,0xF0,0x00,0x00,0x00,0x00,0xFF,0xFF,0xFF,0xFC,0x00,0x00,
0x00,0x01,0xFF,0xC0,0x03,0xFF,0x00,0x00,0x00,0x07,0xFE,0x00,0x00,0x3F,0xC0,0x00,
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0x00,0x00,0x01,0xFF,0xFF,0xC0,0x00,0x00,0x00,0x00,0x00,0x3F,0xFE,0x00,0x00,0x00
};

unsigned char   ew_6464[]={
/*--  调入了一幅图像：E:\`3`hj large files\二维码\6464\64x64-hppt-2.bmp  --*/
/*--  宽度x高度=64x64  --*/
0x00,0x00,0x00,0x00,0x00,0x00,0x00,0x00,0x7F,0xFE,0xF0,0x1D,0x80,0xFF,0x7F,0xFE,
0x7F,0xFE,0xF0,0x1D,0x80,0xFF,0x7F,0xFE,0x7F,0xFE,0xFC,0x1D,0xE3,0xFF,0x7F,0xFE,
0x70,0x06,0x3C,0x01,0xE3,0x9F,0x60,0x0E,0x70,0x06,0x3F,0x7D,0xEF,0xBF,0x60,0x0E,
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0x00,0x00,0x00,0x00,0x00,0x00,0x00,0x00,0x00,0x00,0x00,0x00,0x00,0x00,0x00,0x00
};
